## runtime/torq_hw/hal/SL2610/Kconfig
```kconfig
# SPDX-License-Identifier: GPL-2.0-only
#

menuconfig SYNAPTICS_NPU
  tristate "Synaptics NPU"
  default m
  help
    Synaptics NPU driver support
```
